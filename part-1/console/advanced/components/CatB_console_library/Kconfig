## part-1/console/advanced/components/CatB_console_library/Kconfig
```kconfig
menu "Example Configuration"

    config STORE_HISTORY
        bool "Store command history in flash"
        default y
        help
            Linenoise line editing library provides functions to save and load
            command history. If this option is enabled, initalizes a FAT filesystem
            and uses it to store command history.

    config USE_ADVANCED_CONSOLE
        bool "Use Advanced Console"
        default y
        help
            The advanced console exposes more details to the user and
             is more complex than the basic console, which is simpler.

endmenu
```

## part-1/lcd/i80_controller/sdkconfig.defaults.esp32s3
```kconfig
# Can't set the FPS too high due to the limitation of PSRAM bandwidth
CONFIG_LV_DISP_DEF_REFR_PERIOD=100
```
